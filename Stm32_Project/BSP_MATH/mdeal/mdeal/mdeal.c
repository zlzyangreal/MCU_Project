#include "mdeal.h"

uint16_t DEAL_Buffer[NUM_SIZE]={0};
uint16_t OUTPUT_Buffer[NUM_SIZE]={0};
extern uint16_t ADC_Buffer[];

uint16_t fft_size = NUM_SIZE/4;
float fft_inputbuf[NUM_SIZE*2];	//FFT输入数组
float fft_outputbuf[NUM_SIZE];	//FFT输出数组
uint16_t FFT_OUTPUT_Buffer[NUM_SIZE]={0};

//-----------------------------------------------------------------------------------------------------------------------------------------------//
//
//图像平滑处理
//
//-----------------------------------------------------------------------------------------------------------------------------------------------//

//5点平滑处理，7点精度更高
void smooth5(uint16_t *x,int m)
{
	uint16_t  a[NUM_SIZE]={0};
	int get_i,deal_i,deal_j,deal_k,end_i;
	for(get_i=0;get_i<NUM_SIZE;get_i++)
	{
	  a[get_i] = x[get_i];
	}
	for(deal_i=0;deal_i<m;deal_i++)
	{
	  uint16_t  b[NUM_SIZE]={0};
// 计算第一个元素的平滑值
    b[0] = (69 * a[0] + 4 * (a[1] + a[3]) - 6 * a[2] - a[4]) / 70;
// 计算第二个元素的平滑值
    b[1] = (2 * (a[0] + a[4]) + 27 * a[1] + 12 * a[2] - 8 * a[3]) / 35;
// 对中间的元素进行平滑计算
//    for (deal_j = 2; deal_j < NUM_SIZE - 2; deal_j++)
//		{
//        b[deal_j] = (-3 * (a[deal_j-2] + a[deal_j+2]) + 12 * (a[deal_j-1] + a[deal_j+1]) + 17 * a[deal_j]) / 35;
//    }
//考虑0	,但出现断崖	
		 for (deal_j = 2; deal_j < NUM_SIZE - 2; deal_j++) {
            if (a[deal_j-2] != 0 && a[deal_j-1] != 0 && a[deal_j] != 0 && a[deal_j+1] != 0 && a[deal_j+2] != 0) {
                b[deal_j] = (-3 * (a[deal_j-2] + a[deal_j+2]) + 12 * (a[deal_j-1] + a[deal_j+1]) + 17 * a[deal_j]) / 35;
            } else {
                b[deal_j] = a[deal_j];
            }
        }

// 计算倒数第二个元素的平滑值
    b[NUM_SIZE - 2] = (2 * (a[NUM_SIZE-1] + a[NUM_SIZE-5]) + 27 * a[NUM_SIZE-2] + 12 * a[NUM_SIZE-3] - 8 * a[NUM_SIZE-4]) / 35;
// 计算最后一个元素的平滑值
    b[NUM_SIZE - 1] = (69 * a[NUM_SIZE-1] + 4 * (a[NUM_SIZE-2] + a[NUM_SIZE-4]) - 6 * a[NUM_SIZE-3] - a[NUM_SIZE-5]) / 70;
// 将计算得到的平滑值赋值给变量a
    for (deal_k = 0; deal_k < NUM_SIZE; deal_k++) 
		{
        a[deal_k] = b[deal_k];
    }
	}
	for(end_i=0;end_i<NUM_SIZE;end_i++)
	{
	  DEAL_Buffer[end_i] = a[end_i];
	}
}
//二次函数拟合,采用7点拟合
void qua_smooth(uint16_t *x,int m)
{
  int i,end_i;
	uint16_t  z[NUM_SIZE]={0};
	if(m<7)
	{
	  for(i=0;i<=m-1;i++)
		{
		  OUTPUT_Buffer[i]=x[i];
		}
	}else
	{
	  z[0] = ( 32.0 * x[0] + 15.0 * x[1] + 3.0 * x[2] - 4.0 * x[3] - 6.0 * x[4] - 3.0 * x[5] + 5.0 * x[6] ) / 42.0;
    z[1] = ( 5.0 * x[0] + 4.0 * x[1] + 3.0 * x[2] + 2.0 * x[3] + x[4] - x[6] ) / 14.0;
    z[2] = ( 1.0 * x[0] + 3.0 * x [1] + 4.0 * x[2] + 4.0 * x[3] + 3.0 * x[4] + 1.0 * x[5] - 2.0 * x[6] ) / 14.0;
    for ( i = 3; i <= NUM_SIZE - 4; i++ )
        {
            z[i] = ( -2.0 * (x[i - 3] + x[i + 3]) + 3.0 * (x[i - 2] + x[i + 2]) +  6.0 * (x[i - 1] + x[i + 1]) + 7.0 * x[i] ) / 21.0;
        }
    z[NUM_SIZE - 3] = ( 1.0 * x[NUM_SIZE - 1] + 3.0 * x [NUM_SIZE - 2] + 4.0 * x[NUM_SIZE - 3] + 4.0 * x[NUM_SIZE - 4] + 3.0 * x[NUM_SIZE - 5] + 1.0 * x[NUM_SIZE - 6] - 2.0 * x[NUM_SIZE - 7] ) / 14.0;
    z[NUM_SIZE - 2] = ( 5.0 * x[NUM_SIZE - 1] + 4.0 * x[NUM_SIZE - 2] + 3.0 * x[NUM_SIZE - 3] + 2.0 * x[NUM_SIZE - 4] + x[NUM_SIZE - 5] - x[NUM_SIZE - 7] ) / 14.0;
    z[NUM_SIZE - 1] = ( 32.0 * x[NUM_SIZE - 1] + 15.0 * x[NUM_SIZE - 2] + 3.0 * x[NUM_SIZE - 3] - 4.0 * x[NUM_SIZE - 4] - 6.0 * x[NUM_SIZE - 5] - 3.0 * x[NUM_SIZE - 6] + 5.0 * x[NUM_SIZE - 7] ) / 42.0;
    }
		for(end_i=0;end_i<NUM_SIZE;end_i++)
	{
	  OUTPUT_Buffer[end_i] = z[end_i];
	}
}
void NUM_DEAL(void)
{
   smooth5(ADC_Buffer,50);
	 qua_smooth(DEAL_Buffer,50);
}
//-----------------------------------------------------------------------------------------------------------------------------------------------//
//
//FFT处理
//
//-----------------------------------------------------------------------------------------------------------------------------------------------//

void FFT_DEAL(void)
{
		uint16_t i;
	delay_ms(1);
//	arm_cfft_radix4_instance_f32 scfft;

//	arm_cfft_radix4_init_f32(&scfft,fft_size,0,1);//初始化scfft结构体，设定FFT相关参数
  for(i=0;i<fft_size;i++)
	{
           fft_inputbuf[2*i] = (float32_t)((ADC_Buffer[i] * 3.3)/4096);
//		       fft_inputbuf[2*i]=100+
//				                   10*arm_sin_f32(2*PI*i/fft_size)+
//								   30*arm_sin_f32(2*PI*i*4/fft_size)+
//				                   50*arm_cos_f32(2*PI*i*8/fft_size);	//生成输入信号实部
           fft_inputbuf[2*i + 1] = 0;
  }  
//-----------------------------------------------------------------------//
//
//void arm_cfft_f32{
// const arm_cfft_instance_f32 * S,//指向arm_cfft_instance_f32类型结构体的指针，内部存储了FFT的状态和配置信息
//	                               //只要是2的倍数例如arm_cfft_sR_f32_len64、arm_cfft_sR_f32_len8192
// float32_t * p1,                 //指向输入/输出数据的指针
// uint8_t ifftFlag,               //用于选择是进行正向（FFT）还是逆向（逆FFT）变换。如果设置为1，进行逆向变换；如果设置为0，进行正向变换
// uint8_t bitReverseFlag          //是否进行位反转操作。如果设置为1，进行位反转；如果设置为0，不进行位反转
//}
//	
//-----------------------------------------------------------------------//	
    arm_cfft_f32(&arm_cfft_sR_f32_len1024, fft_inputbuf, 0, 1); 
//     arm_cfft_radix4_f32(&scfft,fft_inputbuf);	//FFT计算（基4）
//-----------------------------------------------------------------------//
//
//该函数用于计算复数序列的模值，即将每个复数的实部和虚部视为坐标平面上的点，计算它们到原点的距离
//|Z| = sqrt(Re^2 + Im^2)	
//	
//-----------------------------------------------------------------------//
    arm_cmplx_mag_f32(fft_inputbuf, fft_outputbuf, fft_size);
  }

	
	
//-----------------------------------------------------------------------------------------------------------------------------------------------//
//
//IIR滤波处理(f4性能不支持使用)
//
//-----------------------------------------------------------------------------------------------------------------------------------------------//
/* IIR滤波的阶数 */
//#define numStages  4 

///* 巴特沃斯低通滤波器系数*/
//const float a[numStages+1] = { 1.0f,-3.835825540647348042000430723419412970543f, 5.52081913662222678595981051330454647541f,-3.533535219463013632434922328684478998184f,
//0.84855599926647662378798031568294391036f};
//const float b[numStages+1] = {0.000000898486146397064471459551013993172f,0.000003593944585588257885838204055972689f,0.000005390916878382387040515542897534118f,0.000003593944585588257885838204055972689f,
//0.000000898486146397064471459551013993172f};

//static float old_x[numStages] = {0.0f};
//static float old_y[numStages] = {0.0f};
//static int pos = 0;

//float arm_iir_f32_bp(float input)
//{
//    int i,p;
//    float output = b[0] * input;
//    for(i=1; i<=numStages; i++)
//    {
//        p=(pos + numStages - i)%numStages;
//        output += b[i] * old_x[p] - a[i] * old_y[p];
//    }
//    if(numStages > 1) {
//        old_x[pos] = input;
//        old_y[pos] = output;
//        pos = (pos+1)%numStages;
//    }
//		
//    return output;
//}
//-----------------------------------------------------------------------------------------------------------------------------------------------//
//
//FIR滤波处理
//
//-----------------------------------------------------------------------------------------------------------------------------------------------//

#define NUM_TAPS 501//滤波器阶数（处理点数）
#define BLOCK_SIZE 1//调用一次函数，处理采样点个数

static float32_t fir_state[BLOCK_SIZE+NUM_TAPS-1];
uint32_t BlockSize = BLOCK_SIZE;
arm_fir_instance_f32 S;

const float fir_matalab_fadtool[NUM_TAPS] = {
-8.095077333e-18,6.715620657e-06,7.970656043e-06, 3.04475634e-06,-8.115351193e-06,
  -2.48693832e-05,-4.591665856e-05,-6.938767183e-05,-9.298833902e-05,-0.0001141867833,
  -0.0001304290636,-0.0001393672137,-0.000139081385,-0.0001282778685,-0.0001064452226,
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  -2.48693832e-05,-8.115351193e-06, 3.04475634e-06,7.970656043e-06,6.715620657e-06,
  -8.095077333e-18
	
};

void fir_init(void)
{
  arm_fir_init_f32(&S,NUM_TAPS,(float32_t*)&fir_matalab_fadtool[0],&fir_state[0],1);
}

float fir_deal(float input)
{
  float output;
	arm_fir_f32(&S,&input,&output,1);
	return output;
}